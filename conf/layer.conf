## conf/layer.conf
```bitbake
BBPATH .= ":${LAYERDIR}"

BBFILES += "${LAYERDIR}/recipes-*/*/*.bb \
    ${LAYERDIR}/recipes-*/*/*.bbappend"

BBFILE_COLLECTIONS += "tflite"
BBFILE_PATTERN_tflite = "^${LAYERDIR}/"
BBFILE_PRIORITY_tflite = "6"
LAYERSERIES_COMPAT_tflite = "zeus dunfell gatesgarth hardknott honister"
```
